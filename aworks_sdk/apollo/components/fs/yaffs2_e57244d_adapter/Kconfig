## aworks_sdk/apollo/components/fs/yaffs2_e57244d_adapter/Kconfig
```kconfig
menuconfig AW_YAFFS_ADAPTER
    bool "yaffs2"
    select YAFFS
    select AW_SHELL
    select AW_MTD
    select AW_POSIX_INTERFACE
    default n


if    AW_YAFFS_ADAPTER 
    config AW_YAFFS_DEBUG_MSG
        bool "Debug Msg Enable"
        default n
        help
          Open yaffs debug info.

    config CONFIG_YAFFS_DEFINES_TYPES
        bool "Defines Types"
        default y
        help
          Use yaffs define data type.

    config CONFIG_YAFFS_PROVIDE_DEFS
        bool "Provide Defs"
        default y
        help
          Use yaffs provide file type and attribute defines.

    config CONFIG_YAFFS_DIRECT
        bool "Direct Interface Enable"
        default y
        help
          Use yaffs direct interface.
endif
```
